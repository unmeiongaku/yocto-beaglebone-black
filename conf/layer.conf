## conf/layer.conf
```bitbake
# We have a conf and classes directory, add to BBPATH
BBPATH .= ":${LAYERDIR}"

# We have recipes-* directories, add to BBFILES
BBFILES += "${LAYERDIR}/recipes-*/*/*.bb \
            ${LAYERDIR}/recipes-*/*/*.bbappend"

BBFILE_COLLECTIONS += "meta-bbb"
BBFILE_PATTERN_meta-bbb = "^${LAYERDIR}/"
BBFILE_PRIORITY_meta-bbb = "6"

LAYERDEPENDS_meta-bbb = "core"
LAYERSERIES_COMPAT_meta-bbb = "scarthgap"
```

## recipes-kernel/bno055-driver/files/Kconfig
```kconfig
config BNO055
	tristate "Bosch BNO055 IMU sensor"
	depends on I2C
	select IIO
	select IIO_BUFFER
	select IIO_TRIGGERED_BUFFER
	help
	  Say yes here to build support for the Bosch BNO055
	  9-axis absolute orientation sensor.

	  This driver supports accelerometer, gyroscope,
	  magnetometer and fusion data via IIO subsystem.

	  To compile this driver as a module, choose M here.
```
