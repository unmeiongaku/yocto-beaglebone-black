## recipes-kernel/bmp280-driver/files/Kconfig
```kconfig
menuconfig BMP280DEV
    tristate "Bosch BMP280 pressure sensor"
    depends on I2C
    depends on REGMAP_I2C
    depends on IIO
    help
      Say yes here to build support for the Bosch BMP280
      pressure and temperature sensor.

      This driver supports pressure and temperature measurement
      via the Industrial I/O (IIO) subsystem.

      To compile this driver as a module, choose M here.
      The module will be called bmp280dev.


if BMP280DEV

config BMP280DEV_I2C
    tristate "BMP280 I2C support"
    depends on I2C
    select REGMAP_I2C
    help
      Enable I2C bus support for BMP280 sensor.

endif
```

## recipes-kernel/ds3231rtc-driver/files/Kconfig
```kconfig
config RTC_DRV_DESMTINY_DS3231
	tristate "Desmtiny DS3231 RTC driver"
	depends on I2C
	select REGMAP_I2C
	help
	  Say yes here to enable support for the DS3231 real-time
	  clock over I2C.

	  This driver supports:
	    - Time read/set
	    - Alarm with interrupt (INT pin)
	    - Integration with Linux RTC subsystem

	  To compile this driver as a module, choose M here:
	  the module will be called ds3231rtcdev.
```

## recipes-kernel/st7735r-driver/files/Kconfig
```kconfig
config DRM_TINY_ST7735R
	tristate "ST7735R 0.96 80x160 support"
	depends on DRM && SPI
	select DRM_KMS_HELPER
	select DRM_MIPI_DBI
```
